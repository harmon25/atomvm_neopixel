## Kconfig
```kconfig
menu "ATOMVM_LED_STRIP Configuration"

config AVM_LED_STRIP_ENABLE
	bool  "Enable AtomVM LED_STRIP driver"
	default y
	help
		Use this parameter to enable or disable the AtomVM LED_STRIP driver.
		
		This driver uses the ESP-IDF led_strip component which provides:
		- Automatic DMA support on ESP32-S3/C6
		- SPI backend fallback for better WiFi coexistence
		- Maintained by Espressif for optimal performance

choice AVM_LED_STRIP_BACKEND
	prompt "LED strip backend"
	default AVM_LED_STRIP_BACKEND_AUTO
	depends on AVM_LED_STRIP_ENABLE
	help
		Select the backend peripheral for driving the LED strip.

config AVM_LED_STRIP_BACKEND_AUTO
	bool "Auto (recommended)"
	help
		Automatically select the best backend for your chip:
		- ESP32: SPI with DMA (best WiFi coexistence)
		- ESP32-S3/C6/P4: RMT with DMA
		- Others: RMT, fallback to SPI

config AVM_LED_STRIP_BACKEND_SPI
	bool "Force SPI"
	help
		Always use SPI backend with DMA.
		Best for WiFi coexistence on all chips.
		Note: Uses entire SPI bus (SPI2_HOST).

config AVM_LED_STRIP_BACKEND_RMT
	bool "Force RMT"
	help
		Always use RMT backend.
		May cause flickering with WiFi on ESP32 (no DMA).
		Works well on ESP32-S3/C6/P4 with DMA.

endchoice

endmenu
```
